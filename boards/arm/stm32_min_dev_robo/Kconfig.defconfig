## boards/arm/stm32_min_dev_robo/Kconfig.defconfig
```kconfig
# STM32 Minimum Development Board Configuration

# Copyright (c) 2017, embedjournal.com
# SPDX-License-Identifier: Apache-2.0

if BOARD_STM32_MIN_DEV_BLUE

config BOARD
	default "stm32_min_dev_robo" 


# SUPA DEFAULTS
config HAS_STM32CUBE
    default y

config USE_STM32_HAL_TIM
    default y
    
config USE_STM32_HAL_TIM_EX
    default y

config USE_STM32_HAL_PWR
    default y

endif # BOARD_STM32_MIN_DEV_BLUE || BOARD_STM32_MIN_DEV_BLACK
```

## boards/arm/stm32f411e_robo/Kconfig.defconfig
```kconfig
# STM32F411E-DISCO board configuration

# Copyright (c) 2017 Fenix Engineering Solutions
# SPDX-License-Identifier: Apache-2.0

if BOARD_STM32F411E_ROBO

config BOARD
	default "stm32f411e_disco"

if UART_CONSOLE

config UART_2
	default y
endif # UART_CONSOLE

config USE_STM32_HAL_TIM_EX
    default y

 

if PWM
config PWM_STM32_2
       default y
endif # PWM


endif # BOARD_STM32F411E_ROBO
```
